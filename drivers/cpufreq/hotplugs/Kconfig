## drivers/cpufreq/hotplugs/Kconfig
```kconfig
config MSM_HOTPLUG
	bool "MSM hotplug driver"
	depends on HOTPLUG_CPU
	default n
	help
	  The MSM hotplug driver controls on-/offlining of additional cores based
	  on current cpu load.

config INTELLI_PLUG_HOTPLUG
	   bool "Hotplug for Razor Reborn"
	   depends on MSM_RUN_QUEUE_STATS
	   default n
	   help

config MAKO_HOTPLUG
    bool "Mako Hotplug"
    default n
    help
      Mako Hotplug: A custom hotplug by fransico franco

config ALUCARD_HOTPLUG
	bool "Enable alucard-hotplug cpu hotplug driver"
	default n
	help
	  Generic Alucard-hotplug cpu hotplug driver for ARM SOCs

config BRICKED_HOTPLUG
	bool "Enable kernel based mpdecision"
	depends on MSM_RUN_QUEUE_STATS
	default n
	help
	  This enables kernel based multi core control.
	  (up/down hotplug based on load)

config LAZYPLUG
	bool "Conservative hotplugging for generic devices"
	default n
	help
	  This enables the conservative hotplugging, lazyplug by arter97
	  based on intelli_plug. Refer to the comments for more info.
```
